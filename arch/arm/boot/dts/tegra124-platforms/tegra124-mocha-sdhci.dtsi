/*
 * arch/arm/boot/dts/tegra124-platforms/tegra124-mocha-sdhci.dtsi
 *
 * Copyright (c) 2017, SmokeTeam. All rights reserved.
 *
 * This program is free software; you can redistribute it and/or modify it
 * under the terms and conditions of the GNU General Public License,
 * version 2, as published by the Free Software Foundation.
 *
 * This program is distributed in the hope it will be useful, but WITHOUT
 * ANY WARRANTY; without even the implied warranty of MERCHANTABILITY or
 * FITNESS FOR A PARTICULAR PURPOSE.  See the GNU General Public License for
 * more details.
 *
 */
 
#include <dt-bindings/gpio/tegra-gpio.h>

/ {
	
 	aliases {
 		sdhci0 = &sdmmc1;
	};
	

	
	/* Wi-Fi */
	sdmmc1: sdhci@700b0000 {
		id = <0>;
 		tap-delay = <0>;
		power-off-rail;
 		trim-delay = <2>;
 		uhs-mask = <8>;
		calib-3v3-offsets = <0x7676>;
		calib-1v8-offsets = <0x7676>;
		max-clk-limit = <136000000>;
		ddr-clk-limit = <41000000>;
		mmc-ocr-mask = <0>;
		default-drv-type = <1>;
		built-in;
 		status = "okay";
	};
};
